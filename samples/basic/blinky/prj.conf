## CMakeLists.txt
```
# SPDX-License-Identifier: Apache-2.0

set(BOARD tracky_one_nucleo)

set(ENV{UBXLIB_DIR} ${CMAKE_CURRENT_LIST_DIR}/../../../../ubx)
include($ENV{UBXLIB_DIR}/zephyr/ubxlib.cmake)

# Add ubxlib as a Zephyr module
set(UBXLIB_FEATURES u_lib;cell)
cmake_path(SET UBX_LIBBASE NORMALIZE ${REPO_ROOT}/ubx)
list(APPEND ZEPHYR_EXTRA_MODULES ${UBXLIB_BASE})

cmake_minimum_required(VERSION 3.20.0)
find_package(Zephyr REQUIRED HINTS $ENV{ZEPHYR_BASE})
project(blinky)

target_sources(app PRIVATE src/main.c)

target_include_directories(app INTERFACE
        $ENV{UBXLIB_DIR}
)
```

## prj.conf
```kconfig
CONFIG_GPIO=y

CONFIG_UBXLIB=y
CONFIG_HEAP_MEM_POOL_SIZE=4096
CONFIG_NEWLIB_LIBC=y

CONFIG_UART_ASYNC_API=y

CONFIG_NETWORKING=y
CONFIG_NET_DRIVERS=y
CONFIG_NET_IPV6=n
CONFIG_NET_IPV4=y
CONFIG_PPP_NET_IF_NO_AUTO_START=y
CONFIG_NET_PPP=y
CONFIG_NET_PPP_ASYNC_UART=y
CONFIG_NET_L2_PPP=y
CONFIG_NET_L2_PPP_PAP=y
CONFIG_NET_L2_PPP_TIMEOUT=10000
CONFIG_NET_PPP_UART_BUF_LEN=512
CONFIG_NET_PPP_ASYNC_UART_TX_BUF_LEN=512

CONFIG_NET_TCP=y
CONFIG_NET_TCP_MAX_SEND_WINDOW_SIZE=256
CONFIG_NET_TCP_MAX_RECV_WINDOW_SIZE=256
CONFIG_NET_SOCKETS=y
CONFIG_TEST_RANDOM_GENERATOR=y
```

## src/main.c
```c
/*
 * Copyright (c) 2016 Intel Corporation
 *
 * SPDX-License-Identifier: Apache-2.0
 */

#include <stdio.h>
#include <zephyr/kernel.h>
#include <zephyr/drivers/gpio.h>


#include <u_cfg_app_platform_specific.h>
#include <ubxlib.h>


static const uDeviceCfg_t gDeviceCfg = {
	.deviceType = U_DEVICE_TYPE_CELL,
	.deviceCfg  = {
		.cfgCell = {
			.moduleType        = U_CELL_MODULE_TYPE_SARA_R5,
			.pSimPinCode       = NULL, /* SIM pin */
			.pinEnablePower    = U_CFG_APP_PIN_CELL_ENABLE_POWER,
			.pinPwrOn          = U_CFG_APP_PIN_CELL_PWR_ON,
			.pinVInt           = U_CFG_APP_PIN_CELL_VINT,
			.pinDtrPowerSaving = U_CFG_APP_PIN_CELL_DTR },
	       },
	       .transportType = U_DEVICE_TRANSPORT_TYPE_UART,
	       .transportCfg  = {
		.cfgUart = {
			.uart = U_CFG_APP_CELL_UART, .baudRate = U_CELL_UART_BAUD_RATE, .pinTxd = U_CFG_APP_PIN_CELL_TXD, .pinRxd = U_CFG_APP_PIN_CELL_RXD, .pinCts = U_CFG_APP_PIN_CELL_CTS, .pinRts = U_CFG_APP_PIN_CELL_RTS,
			.pPrefix = NULL, // Relevant for Linux only
		   },
	       },
	   };

int main(void)
{
	uDeviceHandle_t devHandle = NULL;
	//struct sockaddr_in destinationAddress;
	int32_t sock;
	const char message[] = "The quick brown zephyr-fox jumps over the lazy dog.";
	size_t txSize = sizeof(message);
	char buffer[128];
	size_t rxSize = 0;
	int32_t returnCode;

	// Initialise the APIs we will need
	uPortInit();
	uDeviceInit();

	// Open the device
	returnCode = uDeviceOpen(&gDeviceCfg, &devHandle);
	uPortLog("Opened device with return code %d.\n", returnCode);
}
```
