## drivers/modem/Kconfig.ublox-ubxlib
```kconfig
# u-blox ubxlib modem driver options

# Copyright (c) 2019 Foundries.io
# SPDX-License-Identifier: Apache-2.0

config MODEM_UBLOX_UBXLIB
	bool "U-blox ubxlib modem driver"
	select MODEM_CONTEXT
	select MODEM_CMD_HANDLER
	select MODEM_IFACE_UART
	select MODEM_SOCKET
	select NET_OFFLOAD
	select NET_SOCKETS_OFFLOAD
	help
	  Choose this setting to enable u-blox ubxlib modem driver.


if MODEM_UBLOX_UBXLIB

config MODEM_UBLOX_UBXLIB_RX_STACK_SIZE
	int "Stack size for the u-blox ubxlib modem driver RX thread"
	default 1024
	help
	  This stack is used by the u-blox ubxlib RX thread.


config MODEM_UBLOX_SARA_RSSI_WORK
	bool "RSSI polling work"
	default n
	help
	  u-blox SARA-R4 device is configured to poll for RSSI

config MODEM_UBLOX_SARA_RSSI_WORK_PERIOD
	int "Configure RSSI WORK polling frequency"
	depends on MODEM_UBLOX_SARA_RSSI_WORK
	default 30
	help
	  This settings is used to configure the period of RSSI polling

config MODEM_UBLOX_UBXLIB_INIT_PRIORITY
	int "u-blox ubxlib driver init priority"
	default 80
	help
	  u-blox ubxlib driver initialization priority.
	  Do not mess with it unless you know what you are doing.
	  Note that the priority needs to be lower than the net stack
	  so that it can start before the networking sub-system.

# ... deleted for the moment

endif # MODEM_UBLOX_UBXLIB
```

## dts/bindings/modem/u-blox,ubxlib.yaml
```yaml
# Copyright (c) 2019, Foundries.io
# SPDX-License-Identifier: Apache-2.0

description: u-blox ubxlib modem

compatible: "u-blox,ubxlib"

include: uart-device.yaml

properties:
    mdm-reset-gpios:
      type: phandle-array
      required: false

    mdm-vcc-gpios:
      type: phandle-array
      required: false

    mdm-power-on-gpios:
      type: phandle-array
      required: false

    mdm-vint-gpios:
      type: phandle-array
      required: false
```

## dts/bindings/sensor/st,stm32-vdda.yaml
```yaml
# Copyright (c) 2022 STMicroelectronics
# SPDX-License-Identifier: Apache-2.0

description: STM32 family VDDA node

include: base.yaml

compatible: "st,stm32-vdda"

properties:
    io-channels:
      required: true
      description: ADC channel for Vbat sensor

    ratio:
      type: int
      required: false
      description: fraction of VBat to be connected to the ADC input

    vref-addr:
      type: int
      required: true

    analog-value:
      type: int
      required: true
```
